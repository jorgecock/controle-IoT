/*
 Created by Rui Santos
 Visit: http://randomnerdtutorials.com for more arduino projects

 Arduino with Ethernet Shield
 */

#include <SPI.h>
#include <Ethernet.h>
#include <Servo.h> 
#include <IRremote.h>


char dados;
IRsend irsend; //variável para poder enviar o código a TV   
//variáveis constantes para o controle remoto     
const int ledIR = 9;   


int led = 4;
Servo microservo; 
int pos = 0; 
byte mac[] = { 0xDE, 0xAD, 0xBE, 0xEF, 0xFE, 0xED };   //physical mac address
byte ip[] = { 192, 168, 1, 177 };                      // ip in lan (that's what you need to use in your browser. ("192.168.1.178")
byte gateway[] = { 192, 168, 1, 1 };                   // internet access via router
byte subnet[] = { 255, 255, 255, 0 };                  //subnet mask
EthernetServer server(80);                             //server port     
String readString;



  //DESLIGAR
unsigned int offAir[115]= {3320,1596,404,408,428,388,404,1224,428,388,428,1200,428,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1200,428};

//LIGAR
unsigned int onAir[259]= {3320,1576,424,408,408,408,404,1224,428,368,424,1224,428,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1200,432};

//DOWN
unsigned int downAir[259] = {3320,1592,404,412,428,384,428,1204,428,384,432,1200,428,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1200,432};

//UP
unsigned int upAir[259] = {3324,1596,448,360,408,408,404,1224,456,360,408,1220,456,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384,408};

//SETUP
unsigned int setUpAir[115] = {3320,1596,400,416,400,408,408,1224,452,364,404,1224,452,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1200,428};

//SETDOWN
unsigned int setDownAir[115] = {3320,1596,448,360,408,408,408,1220,456,360,408,1220,460,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1224,456};

//FAN
unsigned int fanAir[259] = {3320,1596,400,412,404,408,408,1220,456,360,408,1224,428,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384,408};

//MODE
unsigned int ModeAir[259] ={3320,1596,452,356,408,408,408,1220,460,356,408,1224,456,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356,408};
  
  unsigned int canal[135]= {4528,4536,536,1708,540,1708,536,1712,536,584,540,584,536,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1708,540};
  unsigned int S_pwr[68]={4600,4350,700,1550,650,1550,650,1600,650,450,650,450,650,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1550,650};
  unsigned int S_pup[68]={4600,4350,700,1500,700,1500,700,1550,700,450,650,400,700,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1550,650};
  unsigned int S_pdown[68]={4650,4300,700,1550,700,1500,700,1550,700,400,700,400,700,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1500,700};
  unsigned int S_vup[68]={4600,4350,650,1550,700,1500,700,1550,700,400,700,400,700,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1550,650};
  unsigned int S_vdown[68]={4600,4350,700,1550,650,1550,700,1500,700,450,650,450,700,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1500,700};


void setup() {
 // Open serial communications and wait for port to open:
  Serial.begin(9600);
   while (!Serial) {
    ; // wait for serial port to connect. Needed for Leonardo only
  }
  pinMode(ledIR ,OUTPUT); // saída do infravermelho   

  microservo.attach(7);
  // start the Ethernet connection and the server:
  Ethernet.begin(mac, ip, gateway, subnet);
  server.begin();
  Serial.print("server is at ");
  Serial.println(Ethernet.localIP());
}


void loop() {
  // Create a client connection
  EthernetClient client = server.available();
  if (client) {
    while (client.connected()) {   
      if (client.available()) {
        char c = client.read();
     
        //read char by char HTTP request
        if (readString.length() < 100) {
          //store characters to string
          readString += c;
          //Serial.print(c);
         }

         //if HTTP request has ended
         if (c == '\n') {          
           Serial.println(readString); //print to serial monitor for debuging
     
           client.println("HTTP/1.1 200 OK"); //send new page
           client.println("Content-Type: text/html");
           client.println();     
           client.println("<HTML>");
           client.println("<HEAD>");
           client.println("<link rel='stylesheet' href='https://maxcdn.bootstrapcdn.com/bootstrap/3.3.5/css/bootstrap.min.css'>");
           client.println("<TITLE>Teste</TITLE>");
           client.println("</HEAD>");
           client.println("<BODY>");
           client.println("<br />");  
           client.println("<H2>Controle TV</H2>");
           client.println("<br />");  
           client.println("<button type='button' class='btn btn-success'><a href=\"/?S_pwr\"\">ON</a></button>");  
           client.println("<button type='button' class='btn btn-danger'><a href=\"/?S_pwr\"\">OFF</a></button>"); 
           client.println("<br />");  
           client.println("<br />");  
           client.println("<button type='button' class='btn btn-warning'><a href=\"/?S_pup\"\">Up Canal</a></button>"); 
           client.println("<button type='button' class='btn btn-info'><a href=\"/?S_pdown\"\">Down Canal</a></button>"); 
           client.println("<br />");  
           client.println("<br />");  
           client.println("<button type='button' class='btn btn-warning'><a href=\"/?S_vup\"\">Up Volume</a></button>");
           client.println("<button type='button' class='btn btn-info'><a href=\"/?S_vdown\"\">Down Volume</a></button>");

           client.println("<br />");  
           client.println("<H2>Controle Ar Condicionado</H2>");
           client.println("<br />");  
           client.println("<button type='button' class='btn btn-success'><a href=\"/?onAir\"\">ON</a></button>");  
           client.println("<button type='button' class='btn btn-danger'><a href=\"/?offAir\"\">OFF</a></button>"); 
           client.println("<br />");  
           client.println("<br />"); 
           client.println("<button type='button' class='btn btn-warning'><a href=\"/?upAir\"\">Up temperatura</a></button>"); 
           client.println("<button type='button' class='btn btn-info'><a href=\"/?downAir\"\">Down temperatura</a></button>"); 
           client.println("<br />");  
           client.println("<br />"); 
           client.println("<button type='button' class='btn btn-warning'><a href=\"/?setUpAir\"\">Set Up</a></button>");
           client.println("<button type='button' class='btn btn-info'><a href=\"/?setDownAir\"\">Set Down</a></button>");
           client.println("<br />");  
           client.println("<br />"); 
           client.println("<button type='button' class='btn btn-warning'><a href=\"/?fanAir\"\">FAN</a></button>");
           client.println("<button type='button' class='btn btn-info'><a href=\"/?modeAir\"\">MODE</a></button>");
      
           client.println("<br />");     
           client.println("<br />"); 
           client.println("</BODY>");
           client.println("</HTML>");
     
           delay(1);
           //stopping client
           client.stop();
           //controls the Arduino if you press the buttons
           if (readString.indexOf("?S_pwr") >0){             
                irsend.sendRaw(S_pwr,68,38); 
                Serial.println("S_pwr");
           }
           if (readString.indexOf("?S_pup") >0){
                irsend.sendRaw(S_pup,68,38); 
                Serial.println("S_pup");
           }
           if (readString.indexOf("?S_pdown") >0){
                irsend.sendRaw(S_pdown,68,38);
                Serial.println("S_pdown"); 
           }
           if (readString.indexOf("?S_vup") >0){
                irsend.sendRaw(S_vup,68,38); 
                Serial.println("S_vup");
           }
           if (readString.indexOf("?S_vdown") >0){
                irsend.sendRaw(S_vdown,68,38); 
                Serial.println("S_vdown");
           }
           if (readString.indexOf("?onAir") >0){
                irsend.sendRaw(onAir,259,38); 
                Serial.println("onAir");
           }
           if (readString.indexOf("?offAir") >0){
                irsend.sendRaw(offAir,259,38); 
                Serial.println("offAir");
           }
           if (readString.indexOf("?upAir") >0){
                irsend.sendRaw(upAir,259,38); 
                Serial.println("upAir");
           }
           if (readString.indexOf("?downAir") >0){
                irsend.sendRaw(downAir,259,38); 
                Serial.println("downAir");
           }
           if (readString.indexOf("?setUpAir") >0){
                irsend.sendRaw(setUpAir,115,38); 
                Serial.println("setUpAir");
           }
           if (readString.indexOf("?setDownAir") >0){
                irsend.sendRaw(setDownAir,115,38); 
                Serial.println("setDownAir");
           }
            if (readString.indexOf("?fanAir") >0){
                irsend.sendRaw(fanAir,259,38); 
                Serial.println("fanAir");
           }
            if (readString.indexOf("?ModeAir") >0){
                irsend.sendRaw(ModeAir,259,38); 
                Serial.println("ModeAir");
           }
           
            //clearing string for next read
            readString="";  
           
         }
       }
    }
}
}
